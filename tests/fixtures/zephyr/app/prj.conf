## CMakeLists.txt
```
cmake_minimum_required(VERSION 3.20.0)
find_package(Zephyr REQUIRED CONFIG)
project(mantle_minimal_firmware C)
target_sources(app PRIVATE src/main.c)
```

## prj.conf
```kconfig
CONFIG_BUILD_OUTPUT_BIN=y
CONFIG_BUILD_OUTPUT_HEX=y
CONFIG_MAIN_STACK_SIZE=1024
CONFIG_BOOT_BANNER=n
CONFIG_TIMESLICING=n
```

## uart.overlay
```dts
/* Explicit overlay, rather than app.overlay auto-discovery. */
&uart0 {
	current-speed = <115200>;
};
```

## src/main.c
```c
/* SPDX-License-Identifier: Apache-2.0 */
#include <zephyr/kernel.h>
#include <zephyr/devicetree.h>
#include <zephyr/sys/printk.h>

int main(void)
{
	printk("Mantle Zephyr fixture: uart=%u stack=%u\n",
	       (unsigned int)DT_PROP(DT_NODELABEL(uart0), current_speed),
	       (unsigned int)CONFIG_MAIN_STACK_SIZE);
	return 0;
}
```
